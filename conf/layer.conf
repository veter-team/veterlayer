## conf/layer.conf
```bitbake
BBFILES += " ${LAYERDIR}/recipes/*/*.bb ${LAYERDIR}/recipes/*/*.bbappend "
BBPATH := "${LAYERDIR}:${BBPATH}"
BBFILE_COLLECTIONS += "veter"
BBFILE_PRIORITY_veter = "30"
BBFILE_PATTERN_veter = "^${LAYERDIR}"
```
